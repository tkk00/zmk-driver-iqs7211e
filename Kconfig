## Kconfig
```kconfig
menuconfig IQS7211E
    bool "IQS7211E capcacitive touch sensor"
  select I2C
    help
      Enable IQS7211E capcacitive touch sensor.

if IQS7211E

config IQS7211E_TAP_EDGE_MARGIN_PERMILLE
    int "Tap ignore edge margin (permille)"
    range 0 450
    default 80
    help
      Edge margin used to suppress tap/click detection in scroller mode.
      80 means 8 percent margin from each edge.

config IQS7211E_TAP_DRAG_WINDOW_MS
    int "Tap-to-drag window (ms)"
    range 100 1000
    default 300
    help
      After a quick tap, if the finger is placed back down within this window,
      a tap-to-drag begins (button held while the finger stays down, released
      when the finger lifts). Similar to the standard touchpad tap-drag gesture.
      Larger values make it easier to trigger a drag but may cause an
      unintended drag when double-clicking quickly.

config IQS7211E_HORIZONTAL_NAVIGATION
    bool "Two-finger horizontal swipe triggers browser back/forward"
    default n
    help
      When enabled, a horizontal two-finger swipe fires browser
      back/forward (mouse buttons 4/5) once per touch instead of
      horizontal scrolling. Vertical scrolling keeps working.
      When disabled (default), horizontal two-finger movement scrolls
      horizontally as usual.

config IQS7211E_NAVIGATION_THRESHOLD
    int "Navigation swipe distance threshold"
    depends on IQS7211E_HORIZONTAL_NAVIGATION
    range 20 2000
    default 200
    help
      Accumulated horizontal movement (in raw sensor units) required to
      trigger a back/forward action. Fires at most once per two-finger
      touch. Larger values require a longer, more deliberate swipe.

config IQS7211E_NAVIGATION_USE_Y_AXIS
    bool "Use raw Y axis for navigation swipe"
    depends on IQS7211E_HORIZONTAL_NAVIGATION
    default n
    help
      Enable this when the trackpad is physically mounted rotated 90
      degrees (i.e. your ZMK config uses INPUT_TRANSFORM_XY_SWAP), so
      the user-horizontal direction corresponds to the sensor's raw Y
      axis. The remaining raw axis keeps scrolling vertically.

config IQS7211E_NAVIGATION_DOMINANCE_PERCENT
    int "Navigation dominance over scroll axis (percent)"
    depends on IQS7211E_HORIZONTAL_NAVIGATION
    range 0 1000
    default 200
    help
      A swipe only fires navigation when the accumulated horizontal
      movement exceeds the accumulated scroll-axis movement by this
      ratio (200 = horizontal must be at least 2x the vertical).
      Prevents slow horizontal drift during long vertical scrolling
      from falsely triggering back/forward. Set 0 to disable the check.

config IQS7211E_NAVIGATION_INVERT
    bool "Invert navigation swipe direction"
    depends on IQS7211E_HORIZONTAL_NAVIGATION
    default n
    help
      Swap which swipe direction means back vs forward.

config IQS7211E_SCROLL_START_THRESHOLD
    int "Two-finger scroll start threshold (raw units)"
    range 0 500
    default 60
    help
      Accumulated two-finger travel required before scrolling begins. A
      two-finger tap moves only slightly, so a nonzero threshold prevents
      taps (and the tiny settle motion when the second finger lands) from
      scrolling. Once exceeded, scrolling continues until the fingers lift.
      Larger = taps are safer but a real scroll needs a bigger initial nudge.

config IQS7211E_SCROLL_DIVISOR
    int "Two-finger scroll divisor (speed)"
    range 1 100
    default 5
    help
      Raw sensor movement is divided by this to produce wheel steps, with
      the remainder carried to the next frame for smooth fine scrolling.
      Larger = slower scrolling. Replaces the old zip_scroll_scaler in the
      ZMK input-processor chain (remove that scaler when using this).

config IQS7211E_SCROLL_DEADZONE
    int "Two-finger scroll deadzone (raw units)"
    range 0 20
    default 2
    help
      Per-frame raw movement at or below this magnitude is treated as zero.
      Suppresses sensor jitter that would otherwise creep or flip direction
      when two fingers rest on the pad. 0 disables the deadzone.

config IQS7211E_TWO_FINGER_GRACE_MS
    int "Two-finger detection grace period (ms)"
    range 0 500
    default 100
    help
      The sensor's two-finger detection can flicker (2 -> 1 -> 2 fingers)
      mid-gesture. Within this window a lost second finger does not end the
      two-finger session: scrolling state, navigation accumulation and
      gesture decisions are kept, and single-finger cursor movement is
      suppressed. Larger values are more forgiving but delay the switch
      back to cursor movement after a real finger lift.

config IQS7211E_SCROLLER_HWHEEL_ZONE_MIN_PERMILLE
    int "HWheel zone start (permille)"
    range 0 1000
    default 0
    help
      Start position of the horizontal scroll zone in permille of Y size.
      This value and MAX define a band [MIN, MAX).

config IQS7211E_SCROLLER_HWHEEL_ZONE_MAX_PERMILLE
    int "HWheel zone end (permille)"
    range 0 1000
    default 150
    help
      End position of the horizontal scroll zone in permille of Y size.
      This value and MIN define a band [MIN, MAX).

config IQS7211E_SCROLLER_INERTIA
    bool "Enable inertia scrolling"
    default n
    help
      Keep sending wheel events after finger release, decaying over time,
      so two-finger scrolling has momentum. Works with both the default
      two-finger scroll and scroller mode. Uses fixed-point integer math
      (no FPU required).

config IQS7211E_SCROLLER_INERTIA_DECAY_PERMILLE
    int "Inertia decay coefficient (permille)"
    range 1 999
    default 920
    depends on IQS7211E_SCROLLER_INERTIA
    help
      Velocity multiplier applied every 10ms tick.
      920 means velocity = velocity * 0.92 per tick.

config IQS7211E_SCROLLER_INERTIA_STOP_THRESHOLD_Q8
    int "Inertia stop threshold (Q8 wheel units per 10ms)"
    range 1 4096
    default 96
    depends on IQS7211E_SCROLLER_INERTIA
    help
      Inertia stops immediately when absolute velocity goes below this value.
      Q8 means 256 equals 1 wheel unit per 10ms.

endif
```
